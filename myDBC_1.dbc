VERSION ""

NS_ :

BS_:

BU_: XXX

BO_ 310 NEW_MSG_1: 8 XXX
 SG_ NEW_SIGNAL_1 : 50|1@0+ (1,0) [0|63] "" XXX
